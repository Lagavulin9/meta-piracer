## conf/layer.conf
```bitbake
BBPATH .= ":${LAYERDIR}"

BBFILES += " \
    ${LAYERDIR}/recipes-*/*/*.bb       \
    ${LAYERDIR}/recipes-*/*/*.bbappend \
"

BBFILE_COLLECTIONS += "template-layer"
BBFILE_PATTERN_template-layer := "^${LAYERDIR}/"

# Setting this variable allows you to prioritize a layer against other
# layers that contain the same recipe. A larger value for the 
# BBFILE_PRIORITY variable results in a higher precedence. 
BBFILE_PRIORITY_template-layer = "9"

LAYERSERIES_COMPAT_template-layer = "kirkstone mickledore"
```
